## conf/distro/cml-base.conf
```bitbake
require conf/distro/poky-tiny.conf
DISTRO = "cml-base"
DISTRO_NAME = "GyroidOS CML (CML Base Distribution)"
DISTRO_VERSION:prepend = "1.1-"
MAINTAINER = "GyroidOS <gyroidos@aisec.fraunhofer.de>"
DISTROOVERRIDES = "poky-tiny:cml-base"
TARGET_VENDOR = "-gyroidos"

INITRAMFS_MAXSIZE = '${@oe.utils.vartrue('DEVELOPMENT_BUILD', "350000", "75000", d)}'

# Toggle for the CI/serial console-capture path (kernel console=, GYROIDOS_LOGTTY,
# dump-diag, the /dev/ttyS2 node). Default off; set to "y" (e.g. via the Jenkins
# parameter) to build a hardware-deployable image with the CI console redirected.
# Weak default so builds that do not go through the local.conf template still
# have it defined.
CI_CONSOLE_REDIRECT ??= "n"

PACKAGECONFIG:remove:pn-gdb = "python"
```

## conf/distro/core-ref.conf
```bitbake
require conf/distro/poky.conf
DISTRO = "core-ref"
DISTRO_NAME = "GyroidOS Core (Core Reference Distro)"
DISTRO_VERSION:prepend = "1.1-"
MAINTAINER = "GyroidOS <gyroidos@aisec.fraunhofer.de>"
DISTROOVERRIDES = "poky:core-ref"
TARGET_VENDOR = "-gyroidos"
```

## conf/layer.conf
```bitbake
BBPATH := "${BBPATH}:${LAYERDIR}" 

BBFILES := "${BBFILES} ${LAYERDIR}/recipes-*/*/*.bb \ 
           ${LAYERDIR}/recipes-*/*/*.bbappend \
	   ${LAYERDIR}/images/*.bb*"


BBFILE_COLLECTIONS += "gyroidos-layer"
BBFILE_PATTERN_gyroidos-layer := "^${LAYERDIR}/"
BBFILE_PRIORITY_gyroidos-layer := "8"

LAYERDEPENDS_gyroidos-layer = "virtualization-layer"

# needed to do iextract tar.xz files in do_fetch
HOSTTOOLS += " xz ssh-keygen "
HOSTTOOLS_NONFATAL += " yarn node nodejs java npm "

LAYERSERIES_COMPAT_gyroidos-layer += "kirkstone"
```

## conf/machine/trustx-corei7-64.conf
```bitbake
# use core-i7 machine from meta-intel
require conf/machine/intel-corei7-64.conf

# overwrite serial consols from intel-corei7-64
SERIAL_CONSOLES = "115200;ttyS0"
```

## scripts/lib/wic/canned-wks/trustmeimage.wks
```
#
# This file was modified from it's original version distributed with poky
#
#
# Copyright(c) 2018 Fraunhofer AISEC
# Fraunhofer-Gesellschaft zur Förderung der angewandten Forschung e.V.
#
# This program is free software; you can redistribute it and/or modify it
# under the terms and conditions of the GNU General Public License,
# version 2 (GPL 2), as published by the Free Software Foundation.
#
# This program is distributed in the hope it will be useful, but WITHOUT
# ANY WARRANTY; without even the implied warranty of MERCHANTABILITY or
# FITNESS FOR A PARTICULAR PURPOSE. See the GPL 2 license for more details.
#
# You should have received a copy of the GNU General Public License along with
# this program; if not, see <http://www.gnu.org/licenses/>
#
# The full GNU General Public License is included in this distribution in
# the file called "COPYING".
#
# Contact Information:
# Fraunhofer AISEC <trustme@aisec.fraunhofer.de>
#


# short-description: Create an UEFI-bootable trustme disk image
# long-description: Create an UEFI-bootable trustme disk image

part /boot --source trustmeboot --label boot --active --align 4 --size 16
part /modules --source trustmemodules --fstype=squashfs --label modules --align 4
part /data --source trustmedata --fstype=btrfs --label data --align 4

bootloader  --ptable gpt
```
